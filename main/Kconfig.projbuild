## sdkconfig.defaults
```kconfig
CONFIG_IDF_TARGET="esp32s3"
CONFIG_ESP_CONSOLE_USB_SERIAL_JTAG=y
CONFIG_ESP_CONSOLE_SECONDARY_NONE=y
CONFIG_BT_ENABLED=y
CONFIG_BT_BLUEDROID_ENABLED=y
CONFIG_BT_GATTC_ENABLE=y
# CONFIG_BT_GATTS_ENABLE is not set
# CONFIG_BT_BLE_SMP_ENABLE is not set
CONFIG_BT_BLE_42_FEATURES_SUPPORTED=y
CONFIG_BT_BLE_42_SCAN_EN=y
# CONFIG_BT_BLE_50_FEATURES_SUPPORTED is not set
CONFIG_PARTITION_TABLE_TWO_OTA_LARGE=y
CONFIG_ESPTOOLPY_FLASHSIZE_4MB=y
CONFIG_JINJIAN_LOG_LEVEL_DEFAULT=3
CONFIG_JINJIAN_MAX_LOG_STREAMS=1
CONFIG_JINJIAN_LED_ENABLE_DEFAULT=y
CONFIG_JINJIAN_PWR_LED_GPIO=-1
CONFIG_JINJIAN_PWR_LED_ACTIVE_LOW=n
CONFIG_JINJIAN_STATUS_LED_GPIO=-1
CONFIG_JINJIAN_STATUS_LED_ACTIVE_LOW=n
CONFIG_JINJIAN_WS2812_GPIO=48
CONFIG_JINJIAN_WS2812_LED_COUNT=1
CONFIG_JINJIAN_FACTORY_RESET_GPIO=0
CONFIG_JINJIAN_FACTORY_RESET_ACTIVE_LOW=y
CONFIG_JINJIAN_FACTORY_RESET_HOLD_MS=3000
CONFIG_JINJIAN_JK_TX_GPIO=2
CONFIG_JINJIAN_JK_RX_GPIO=1
CONFIG_JINJIAN_VEH_TX_GPIO=4
CONFIG_JINJIAN_VEH_RX_GPIO=3
CONFIG_JINJIAN_LTE_ENABLE=y
CONFIG_JINJIAN_LTE_UART_NUM=2
CONFIG_JINJIAN_LTE_TX_GPIO=12
CONFIG_JINJIAN_LTE_RX_GPIO=11
CONFIG_JINJIAN_LTE_EN_GPIO=13
CONFIG_JINJIAN_LTE_EN_ACTIVE_LOW=y
CONFIG_JINJIAN_LTE_EN_PULSE_MS=2000
CONFIG_JINJIAN_LTE_BAUD=115200
CONFIG_JINJIAN_LTE_APN=""
CONFIG_JINJIAN_MQTT_ENABLE=y
CONFIG_JINJIAN_MQTT_BROKER_HOST="399.run"
CONFIG_JINJIAN_MQTT_BROKER_PORT=1883
CONFIG_JINJIAN_MQTT_USERNAME="mqtt"
CONFIG_JINJIAN_MQTT_PASSWORD="test"
CONFIG_JINJIAN_MQTT_TOPIC_PREFIX="/bms"
CONFIG_JINJIAN_MQTT_SAMPLE_INTERVAL_MS=1000
CONFIG_JINJIAN_MQTT_BATCH_SAMPLES=30
CONFIG_JINJIAN_MQTT_KEEPALIVE_S=60
CONFIG_JINJIAN_IDLE_LOW_POWER=y
CONFIG_JINJIAN_IDLE_TIMEOUT_MS=30000
```
